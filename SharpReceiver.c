#include"c8051f120.h"  
#include <math.h>
#include "IBSP.h"
#include "IBase.h"
#include "IDVBSxRx.h"
#include "ITuner.h"
#include "ExtSharpBS2S7HZ6306.h"
#include "II2C.h"
#include "IDiseqc.h"
#include "Sharp.h" 
#include "avl2108.h"
#include "station.h"


static code   struct Signal_Level  SignalLevel [47]=
{
	{8285,	-922},{10224,	-902},{12538,	-882},{14890,	-862},{17343,	-842},{19767,	-822},{22178,	-802},{24618,	-782},{27006,	-762},{29106,	-742},
	{30853,	-722},{32289,	-702},{33577,	-682},{34625,	-662},{35632,	-642},{36552,	-622},{37467,	-602},{38520,	-582},{39643,	-562},{40972,	-542},
	{42351,	-522},{43659,	-502},{44812,	-482},{45811,	-462},{46703,	-442},{47501,	-422},{48331,	-402},{49116,	-382},{49894,	-362},{50684,	-342},
	{51543,	-322},{52442,	-302},{53407,	-282},{54314,	-262},{55208,	-242},{56000,	-222},{56789,	-202},{57544,	-182},{58253,	-162},{58959,	-142},
	{59657,	-122},{60404,	-102},{61181,	-82},{62008,	-62},{63032,	-42},{65483,	-22},{65535,	-12}
};


static code unsigned char ucDemodPatchData [] = 
{
0x00, 0x00, 0x13, 0x00, 0x00, 0x00, 0x00, 0x3C, 0x00, 0x00, 0x1C, 0x70, 0x00, 0x00, 0x08, 0x70, 
0x41, 0x43, 0x00, 0xD2, 0x41, 0x1F, 0xB3, 0x3E, 0x41, 0x59, 0xF3, 0x4D, 0x41, 0x57, 0xE4, 0x26, 
0x41, 0x50, 0x5E, 0x9E, 0x41, 0x52, 0xD3, 0xC3, 0x41, 0x84, 0xB5, 0x74, 0x41, 0x85, 0x82, 0x41, 
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0x00, 0x10, 0x02, 0x08
};


struct A2108_Chip  A2108Chip;	//芯片
struct A2108_Chip * pA2108Chip = &A2108Chip;
struct AVL_Tuner Tuner;			//调谐器
struct AVL_Tuner * pTuner =&Tuner;
struct A2108_Channel Channel;  	//信道
AVL_uint16  uiLockStatus=0;
/***************main函数*****************/
struct A2108_PllConf  pll_conf={10, 0, 335, 6, 4, 4000, 11200, 16800, 22400};

/*需要初始化*/
char SetSharpFreq(float tuner_freq,float  signal_symbolrate)
{
	unsigned char Initialflag = 1;
	int i = 0;

	SFRPAGE = CONFIG_PAGE;
	DVBSTART;
	Delay(11000);
	DVBEND;
	Delay(11000);
	   
	Initialflag = SetSharpFreq_sub(tuner_freq,signal_symbolrate);
	while(!Initialflag)
	{
		Initialflag = SetSharpFreq_sub(tuner_freq,signal_symbolrate);
		Delay(10000);
		if(i==5)
		{
			EA=1;
			return false; //最多设5次，不成功返回失败	  
		}
		i++;
	}
	return true;
}

char SetSharpFreq_sub(float tuner_freq,float  signal_symbolrate)
{		
	A2108_ErrorCode r=1;
	
	r = Initialize(pA2108Chip,pTuner); 	
	if(0!=r) return(false);
	
	//Change the value defined by macro and go back here when we want to lock a new channel.
	//改变由宏定义的值，如果想锁定一个新的信道就返回此处
	signal_symbolrate = signal_symbolrate*1000;  //!!!!!!!!!!!!! 需要和便携的单位统一
	
	pTuner->m_uiFrequency_100kHz = tuner_freq*10; //载波频率The carrier frequency.  The  tuner acquires lock to this frequency value. 
	A2108_ITuner_CalculateLPF(signal_symbolrate/10000,  pTuner);
	//	pTuner->m_uiLPF_100kHz = tuner_LPF;	          //The LPF value of the tuner.
	
	//Halt CPU to improve the tuner locking speed. It's the optional operation before locking tuner.
	//中断CPU以提高tuner锁定速度。它是tuner锁定前的选项操作。
    r=CPU_Halt(pA2108Chip);
	if(0!=r) return(false);
    //This function should be called after initialization to lock the tuner.
	//***********此函数应该初始化之后被调用来锁定tuner	****************
	r = pTuner->m_pLockFunc(pTuner);  //利用参数，设置tuner为锁定状态Function pointer, point to a function which set up the tuner to lock status with all the parameters. 
	if(0!=r) return(false);
	
	A2108_IBSP_Delay_ms(150);		//等待一段时间，让tuner锁定一个特定的频率  
	
	//This function should be called to check the lock status of the tuner.
	//这个函数被调用来核实tuner的lock状态
	r = pTuner->m_pGetLockStatusFunc(pTuner);
//	if(0!=r) return(false);
	
	/*mFlags初始值为0*/
	Channel.m_uiSymbolRate_Hz = signal_symbolrate;     //30M改变由宏定义的值，如果想锁定一个新的信道就返回此处
	Channel.m_Flags = (CI_FLAG_IQ_NO_SWAPPED) << CI_FLAG_IQ_BIT;     //0x00左移0位	IQ不交换
	Channel.m_Flags |= (CI_FLAG_IQ_AUTO_BIT_AUTO) << CI_FLAG_IQ_AUTO_BIT;	//0x01左移5位，启动自动IQ交换探测Enable automatic IQ swap detection
	Channel.m_Flags |= (CI_FLAG_DVBS2_UNDEF) << CI_FLAG_DVBS2_BIT;			//0x04左移2位，自动检测信号标准
	//This function should be called after tuner locked to lock the channel.
	//************tuner锁定后调用这个函数去锁定channel ******************
	r = A2108_IDVBSxRx_LockChannel(&Channel, pA2108Chip);      
//	if(0!=r) return(false);
	
	return(true);
}  


/*无需初始化*/
char SetSharpFreq1(float tuner_freq,float  signal_symbolrate)	 
{
	unsigned char Setsharpflag = 1;
	int i = 0;
	   
	Setsharpflag = SetSharpFreq1_sub(tuner_freq,signal_symbolrate);
	while(!Setsharpflag)
	{
		Setsharpflag = SetSharpFreq1_sub(tuner_freq,signal_symbolrate);
		Delay(10000);
		if(i==5)
		{
			EA=1;
			return false; //最多设5次，不成功返回失败	  
		}
		i++;
	}
	return true;
}

char SetSharpFreq1_sub(float tuner_freq,float  signal_symbolrate)
{	
	A2108_ErrorCode r=A2108_EC_OK;
	
	AVL_uint32 Data=0 ;
    AVL_puint32 Pdata=&Data ;
	
	A2108_II2C_Read32(0x000c, 0x00100000, Pdata ); 	
    Data=(*Pdata);	
	
	/*	r=Initialize(pA2108Chip,pTuner);
	if(0!=r) return(false);	  */
	
	//Change the value defined by macro and go back here when we want to lock a new channel.
	//改变由宏定义的值，如果想锁定一个新的信道就返回此处
	signal_symbolrate = signal_symbolrate*1000;  //!!!!!!!!!!!!! 需要和便携的单位统一
	
	pTuner->m_uiFrequency_100kHz = tuner_freq*10; //载波频率The carrier frequency.  The  tuner acquires lock to this frequency value. 
	A2108_ITuner_CalculateLPF(signal_symbolrate/10000,  pTuner);
	
	//	pTuner->m_uiLPF_100kHz = tuner_LPF;	          //The LPF value of the tuner.
	
	//Halt CPU to improve the tuner locking speed. It's the optional operation before locking tuner.
	//中断CPU以提高tuner锁定速度。它是tuner锁定前的选项操作。
    r=CPU_Halt(pA2108Chip);
	if(0!=r) return(false);
	
    //This function should be called after initialization to lock the tuner.
	//***********此函数应该初始化之后被调用来锁定tuner	****************
	r = pTuner->m_pLockFunc(pTuner);  //利用参数，设置tuner为锁定状态Function pointer, point to a function which set up the tuner to lock status with all the parameters. 
	if(0!=r) return(false);
	
	A2108_IBSP_Delay_ms(150);		//等待一段时间，让tuner锁定一个特定的频率  
	
	//This function should be called to check the lock status of the tuner.
	//这个函数被调用来核实tuner的lock状态
	r = pTuner->m_pGetLockStatusFunc(pTuner);
//	if(0!=r) return(false);
		
	/*mFlags初始值为0*/
	Channel.m_uiSymbolRate_Hz = signal_symbolrate;     //30M改变由宏定义的值，如果想锁定一个新的信道就返回此处
	Channel.m_Flags = (CI_FLAG_IQ_NO_SWAPPED) << CI_FLAG_IQ_BIT;     //0x00左移0位	IQ不交换
	Channel.m_Flags |= (CI_FLAG_IQ_AUTO_BIT_AUTO) << CI_FLAG_IQ_AUTO_BIT;	//0x01左移5位，启动自动IQ交换探测Enable automatic IQ swap detection
	Channel.m_Flags |= (CI_FLAG_DVBS2_UNDEF) << CI_FLAG_DVBS2_BIT;			//0x04左移2位，自动检测信号标准
	//This function should be called after tuner locked to lock the channel.
	//************tuner锁定后调用这个函数去锁定channel ******************
	r = A2108_IDVBSxRx_LockChannel(&Channel, pA2108Chip);      
//	if(0!=r) return(false);
	
	return (true); 	
}





A2108_ErrorCode CPU_Halt(struct A2108_Chip * pA2108Chip)
{
	A2108_ErrorCode r;
	AVL_uint16 i= 0;
	
	r = A2108_IBase_SendRxOP(OP_RX_HALT, pA2108Chip );	   //0x04  发送OP_RX_HALT命令给2108
	
	if(A2108_EC_OK == r) 
	{
		while(i++<20)
		{
			r = A2108_IBase_GetRxOPStatus(pA2108Chip);
			if(A2108_EC_OK == r)
			{
				break;
			}
			else
			{
				A2108_IBSP_Delay_ms(10);	
			}
		}
	}
	return (r);  
}


A2108_ErrorCode Initialize(struct A2108_Chip *pA2108Chip,struct AVL_Tuner *pTuner)
{
    struct A2108_Diseqc_Para sDiseqcPara;
	struct A2108_MpegInfo sMpegMode;   //图像信息
	A2108_ErrorCode r=0;
	//	int i;	
	//  struct A2108_VerInfo  pVerInfo;
	
    // This function should be called after bsp initialized to initialize the chip object.
	//在BSP初始化后，此函数去初始化芯片对象时被调用
    r = InitA2108ChipObject(pA2108Chip, A2108_SA_0);	//芯片对象初始化，芯片地址位A2108_SA_0
	if(0!=r) return(1);
	
	
	//  A2108_IBase_GetVersion(&pVerInfo,  pA2108Chip );
	
    //This function should be called after chip object initialized to initialize the IBase,using reference clock as 10M. Make sure you pickup the right pll_conf since it may be modified in BSP.
	//在芯片对象初始化之后，此函数去初始化IBASE ，采样参考时钟10M	。它可能在IBSP中被修改，要确保正确的pll-conf
	
	r = A2108_IBase_Initialize(&pll_conf, ucDemodPatchData, pA2108Chip);                                                                                   //初始化IBASE
	
	if(0!=r) return(1);
	A2108_IBSP_Delay_ms(100);	//Wait 100 ms to assure that the AVL2108 chip boots up.This function should be implemented by customer.
	//This function should be called to verify the AVL2108 chip has completed its initialization procedure.
	//此函数应当被用户执行，此函数被调用以校验2108芯片完成初始化程序
	
    r = A2108_IBase_GetStatus(pA2108Chip);	//返回2108初始化状态信息
	
	if(0!=r) return(1);		 								  
	
	
    //This function should be called after IBase initialized to initialize the demod.
	// Base初始化之后，初始化demod
	r = A2108_IDVBSxRx_Initialize(pA2108Chip);	 //把demodfre、fecfre、mpegfre写入寄存器
	if(0!=r) return(1);
	
	//This function should be called after demod initialized to set RF AGC polar.
	//User does not need to setup this for Sharp tuner since it is the default value. But for other tuners, user may need to do it here.
    //demod初始化之后调用这个函数来设置RF AGC的极化方式
	//用户不需要为sharp tuner设置这个，因为是默认值。其他的tuner，需要设置
	r = A2108_IDVBSxRx_SetRFAGCPola(A2108_RA_Invert, pA2108Chip); //设置相反模式
	if(0!=r) return(1);
	
	//Setup MPEG mode parameters.
    sMpegMode.m_mpf = A2108_MPF_TS;			 //Transport Stream (TS) Mode. 1个同步位+187数据位
	sMpegMode.m_mpm = A2108_MPM_Parallel; 	 //串行
	sMpegMode.m_mpcm = A2108_MPCM_Falling; // MPEG输出信号在MPEG-CLK下降沿采样 	
	//This function should be called after demod initialized to set MPEG mode.
	//demod初始化之后设置MPEG模式
	r = A2108_IDVBSxRx_SetMpegMode(&sMpegMode,pA2108Chip );	//设置图像模式
	if(0!=r) return(1);
	
	//Setup tuner parameters for tuner initialization.
	//为tuner初始化设置参数
	pTuner->m_uiSlaveAddress = tuner_slave_address;  //c0  The Tuner slave address. It is the write address of the tuner device. i.e. it is 8 bits address and the last bit is the R/W flag which is zero. Although this data structure support 10 bits I2C address. The AVL2108 chip not supports it.     
	pTuner->m_uiI2CBusClock_kHz = tuner_I2Cbus_clock;  //200khz    	
    pTuner->m_pParameters = 0;     //为使用默认参数，参考6306锁定函数     
    pTuner->m_pAVLChip = pA2108Chip;                // Point to a AVL2108 chip	object which the tuner connects to.   
	
	pTuner->m_pInitializeFunc = &ExtSharpBS2S7HZ6306_Initialize;  //指向tuner初始化的函数指针  
	pTuner->m_pLockFunc = &ExtSharpBS2S7HZ6306_Lock;   //函数利用参数设置tuner为lock状态
	pTuner->m_pGetLockStatusFunc = &ExtSharpBS2S7HZ6306_GetLockStatus;	//为tuner报告lock状态 
	//This function should be called after IBase initialized to initialize the tuner.
	//IBase初始化之后，初始化tuner
	r = pTuner->m_pInitializeFunc(pTuner); //tuner初始化
	if(0!=r) return(1);
	
	//Setup Diseqc parameters for Diseqc initialization.
	//为Diseqc初始化设置参数
	sDiseqcPara.m_RxTimeout = A2108_DRT_150ms;	  //接收窗	 < = 0  Wait 150 ms and close the input FIFO.
	sDiseqcPara.m_RxWaveForm = A2108_DWM_Normal;   // Receiver Wave format.	< = 0  The normal wave mode.
	sDiseqcPara.m_ToneFrequency_kHz = Diseqc_Tone_Frequency; 	///< The Diseqc bus speed in the unit of kHz. Normally, it should be 22kHz. 	
	sDiseqcPara.m_TXGap = A2108_DTXG_15ms;		  ///< transmit gap.  The gap is 15 ms.
	sDiseqcPara.m_TxWaveForm = A2108_DWM_Normal;
	
	//The Diseqc should be initialized if AVL2108 need to supply power to LNB. This function should be called after IBase initialized to initialize the Diseqc.
	//如果2108需要向LNB供电，Diseqc应该初始化。应该在IBase初始化之后去初始化Diseqc
	r = A2108_IDiseqc_Initialize(&sDiseqcPara, pA2108Chip);
	if(0!=r) return(1);
	return (r);
}	 

